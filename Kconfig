## Kconfig
```kconfig
menu "PN532"

	config PN532_DEBUG_DX
	bool "Debug DX"
	default n
	help
		Debug DESFire messages and errors

	config PN532_DEBUG_MSG
	bool "Debug MSG"
	default n
	help
		Debug message level

	config PN532_DUMP
	bool "Dump Serial"
	default n
	help
		Dump all serial data to/from PN532

endmenu
```
